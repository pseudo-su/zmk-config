## config/west.yml
```yaml
manifest:
  remotes:
    - name: zmkfirmware
      url-base: https://github.com/zmkfirmware
    # - name: pseudo-su
    #   url-base: https://github.com/pseudo-su
    - name: m165437
      url-base: https://github.com/M165437
  projects:
    - name: zmk
      remote: zmkfirmware
      revision: main
      import: app/west.yml
    # - name: nice-view-thorne
    #   remote: pseudo-su
    #   revision: main
    - name: nice-view-gem
      remote: m165437
      revision: main
  self:
    path: config
```
